SECTIONS
{
    __romPos = 0;
    _gp = 0x0;
    header_ROM_START = __romPos;
    header_VRAM = ADDR(.header);
    .header : AT(header_ROM_START) SUBALIGN(2)
    {
        header_DATA_START = .;
        header = .;
        build/asm/header.o(.data);
        header_DATA_END = .;
        header_DATA_SIZE = ABSOLUTE(header_DATA_END - header_DATA_START);
    }
    __romPos += SIZEOF(.header);
    header_ROM_END = __romPos;
    header_VRAM_END = .;

    _80_ROM_START = __romPos;
    _80_VRAM = ADDR(._80);
    ._80 : AT(_80_ROM_START) SUBALIGN(2)
    {
        _80_DATA_START = .;
        _80 = .;
        build/assets/80.o(.data);
        _80_DATA_END = .;
        _80_DATA_SIZE = ABSOLUTE(_80_DATA_END - _80_DATA_START);
    }
    __romPos += SIZEOF(._80);
    _80_ROM_END = __romPos;
    _80_VRAM_END = .;

    main_ROM_START = __romPos;
    main_VRAM = ADDR(.main);
    .main 0x80010000 : AT(main_ROM_START) SUBALIGN(4)
    {
        main_RODATA_START = .;
        build/asm/data/800.rodata.o(.rodata);
        build/asm/data/1650.rodata.o(.rodata);
        build/asm/data/16F0.rodata.o(.rodata);
        build/asm/data/1740.rodata.o(.rodata);
        build/asm/data/1880.rodata.o(.rodata);
        build/asm/data/19D0.rodata.o(.rodata);
        build/asm/data/1F90.rodata.o(.rodata);
        build/asm/data/2460.rodata.o(.rodata);
        build/asm/data/25A0.rodata.o(.rodata);
        build/asm/data/2830.rodata.o(.rodata);
        build/asm/data/2DF0.rodata.o(.rodata);
        build/asm/data/2E10.rodata.o(.rodata);
        build/asm/data/2E30.rodata.o(.rodata);
        build/asm/data/2E50.rodata.o(.rodata);
        build/asm/data/3110.rodata.o(.rodata);
        build/asm/data/3160.rodata.o(.rodata);
        build/asm/data/3190.rodata.o(.rodata);
        build/asm/data/3470.rodata.o(.rodata);
        build/asm/data/36B0.rodata.o(.rodata);
        build/asm/data/38B0.rodata.o(.rodata);
        build/asm/data/3CE0.rodata.o(.rodata);
        main_RODATA_END = .;
        main_RODATA_SIZE = ABSOLUTE(main_RODATA_END - main_RODATA_START);
        main_TEXT_START = .;
        build/asm/main.o(.text);
        build/asm/libc2/setjmp.o(.text);
        build/asm/libgpu/sys.o(.text);
        build/asm/libc/c42.o(.text);
        build/asm/libc/c63.o(.text);
        build/asm/libc/c73.o(.text);
        build/asm/libapi/a36.o(.text);
        build/asm/libapi/a37.o(.text);
        build/asm/libapi/a39.o(.text);
        build/asm/libetc/vsync.o(.text);
        build/asm/libapi/a91.o(.text);
        build/asm/libapi/l10.o(.text);
        build/asm/libetc/intr.o(.text);
        build/asm/libapi/a23.o(.text);
        build/asm/libapi/a24.o(.text);
        build/asm/libapi/a25.o(.text);
        build/asm/libetc/intr_vb.o(.text);
        build/asm/libetc/intr_dma.o(.text);
        build/asm/code_9BBC_setget.o(.text);
        build/asm/9BEC.o(.text);
        build/asm/libcard/patch.o(.text);
        build/asm/D554.o(.text);
        build/asm/D5D4.o(.text);
        build/asm/libc/c40.o(.text);
        build/asm/E3F4.o(.text);
        build/asm/CAMERA.o(.text);
        build/asm/libgte/msc01.o(.text);
        build/asm/libgte/mtx_000.o(.text);
        build/asm/libgte/mtx_001.o(.text);
        build/asm/libgte/mtx_003.o(.text);
        build/asm/libgte/mtx_01.o(.text);
        build/asm/libgte/mtx_09.o(.text);
        build/asm/libgte/mtx_12.o(.text);
        build/asm/libgte/func_8001EBC8.o(.text);
        build/asm/libgte/ratan.o(.text);
        build/asm/F568.o(.text);
        build/asm/libgte/reg10.o(.text);
        build/asm/LIBPOLY.o(.text);
        build/asm/OBJECT.o(.text);
        build/asm/libgte/mtx_11.o(.text);
        build/asm/libgte/smp_04.o(.text);
        build/asm/LP_OT.o(.text);
        build/asm/libgpu/p07.o(.text);
        build/asm/LP_ANM.o(.text);
        build/asm/LP_GMD.o(.text);
        build/asm/LP_MODEL.o(.text);
        build/asm/LP_MAT.o(.text);
        build/asm/LIGHT_0.o(.text);
        main_DATA_START = .;
        _18E38_data = .;
        build/asm/data/18E38.data.o(.data);
        build/asm/18FB8.o(.text);
        build/asm/libpad/pdcmd1.o(.text);
        build/asm/libpad/pdcmd2.o(.text);
        build/asm/1EDD8.o(.text);
        build/asm/1EF38.o(.text);
        build/asm/1F008.o(.text);
        build/asm/1F108.o(.text);
        build/asm/1FD08.o(.text);
        build/asm/21B78.o(.text);
        build/asm/2AE58.o(.text);
        build/asm/UNPAC.o(.text);
        build/asm/SYSPROC.o(.text);
        build/asm/GPUMAN.o(.text);
        build/asm/libgpu/e03.o(.text);
        build/asm/libgpu/e04.o(.text);
        build/asm/2FE94.o(.text);
        build/asm/2FEC4.o(.text);
        build/asm/libgpu/p33.o(.text);
        build/asm/SOUND.o(.text);
        build/asm/libsnd/ut_roff.o(.text);
        build/asm/libsnd/ut_ron.o(.text);
        build/asm/libspu/s_sr.o(.text);
        build/asm/libspu/s_m_util.o(.text);
        build/asm/libspu/s_srmp.o(.text);
        build/asm/libspu/s_sra.o(.text);
        build/asm/libspu/s_rrwa.o(.text);
        build/asm/36B30.o(.text);
        build/asm/libapi/a10.o(.text);
        build/asm/36D20.o(.text);
        build/asm/libc/c31.o(.text);
        build/asm/36E50.o(.text);
        build/asm/37120.o(.text);
        build/asm/37450.o(.text);
        build/asm/379D0.o(.text);
        build/asm/37E80.o(.text);
        build/asm/37F10.o(.text);
        build/asm/38350.o(.text);
        build/asm/38530.o(.text);
        build/asm/38AA0.o(.text);
        build/asm/38AE0.o(.text);
        build/asm/38FB0.o(.text);
        build/asm/39000.o(.text);
        build/asm/3DDA0.o(.text);
        build/asm/3DE50.o(.text);
        build/asm/libc/c20.o(.text);
        build/asm/3F2B4.o(.text);
        build/asm/TEXMAN.o(.text);
        build/asm/MAINSUB.o(.text);
        build/asm/mainproc.o(.text);
        build/asm/MEMCARD.o(.text);
        build/asm/libmcrd/libmcrd.o(.text);
        build/asm/libapi/a50.o(.text);
        build/asm/libapi/a51.o(.text);
        build/asm/libapi/a54.o(.text);
        build/asm/libapi/a67.o(.text);
        build/asm/libapi/first.o(.text);
        build/asm/libapi/a66.o(.text);
        build/asm/libcard/c171.o(.text);
        build/asm/libcard/c172.o(.text);
        build/asm/libcard/card.o(.text);
        build/asm/libcard/a78.o(.text);
        build/asm/libcard/a80.o(.text);
        build/asm/libmcrd/userfunc.o(.text);
        build/asm/libmcrd/bios.o(.text);
        build/asm/libmcrd/low.obj.o(.text);
        build/asm/libcard/a79.o(.text);
        build/asm/4A444.o(.text);
        build/asm/4AEF0.o(.text);
        build/asm/4AF30.o(.text);
        build/asm/4AF60.o(.text);
        build/asm/libsnd/ut_ako.obj.o(.text);
        build/asm/libgte/smp_01_1.o(.text);
        build/asm/DISPBMP.o(.text);
        build/asm/TMD_SCAN.o(.text);
        build/asm/MEMMENU.o(.text);
        build/asm/WINDOW.o(.text);
        build/asm/51160.o(.text);
        build/asm/51540.o(.text);
        build/asm/51600.o(.text);
        build/asm/516C0.o(.text);
        build/asm/517C0.o(.text);
        build/asm/518E0.o(.text);
        build/asm/519C0.o(.text);
        build/asm/EFFECT.o(.text);
        main_TEXT_END = .;
        main_TEXT_SIZE = ABSOLUTE(main_TEXT_END - main_TEXT_START);
        _52EB0_data = .;
        build/asm/data/52EB0.data.o(.data);
        main_DATA_END = .;
        main_DATA_SIZE = ABSOLUTE(main_DATA_END - main_DATA_START);
    }
    main_bss_VRAM = ADDR(.main_bss);
    .main_bss (NOLOAD) : SUBALIGN(4)
    {
        main_BSS_START = .;
        build/asm/data/800.rodata.o(.bss);
        build/asm/data/1650.rodata.o(.bss);
        build/asm/data/16F0.rodata.o(.bss);
        build/asm/data/1740.rodata.o(.bss);
        build/asm/data/1880.rodata.o(.bss);
        build/asm/data/19D0.rodata.o(.bss);
        build/asm/data/1F90.rodata.o(.bss);
        build/asm/data/2460.rodata.o(.bss);
        build/asm/data/25A0.rodata.o(.bss);
        build/asm/data/2830.rodata.o(.bss);
        build/asm/data/2DF0.rodata.o(.bss);
        build/asm/data/2E10.rodata.o(.bss);
        build/asm/data/2E30.rodata.o(.bss);
        build/asm/data/2E50.rodata.o(.bss);
        build/asm/data/3110.rodata.o(.bss);
        build/asm/data/3160.rodata.o(.bss);
        build/asm/data/3190.rodata.o(.bss);
        build/asm/data/3470.rodata.o(.bss);
        build/asm/data/36B0.rodata.o(.bss);
        build/asm/data/38B0.rodata.o(.bss);
        build/asm/data/3CE0.rodata.o(.bss);
        build/asm/main.o(.bss);
        build/asm/libc2/setjmp.o(.bss);
        build/asm/libgpu/sys.o(.bss);
        build/asm/libc/c42.o(.bss);
        build/asm/libc/c63.o(.bss);
        build/asm/libc/c73.o(.bss);
        build/asm/libapi/a36.o(.bss);
        build/asm/libapi/a37.o(.bss);
        build/asm/libapi/a39.o(.bss);
        build/asm/libetc/vsync.o(.bss);
        build/asm/libapi/a91.o(.bss);
        build/asm/libapi/l10.o(.bss);
        build/asm/libetc/intr.o(.bss);
        build/asm/libapi/a23.o(.bss);
        build/asm/libapi/a24.o(.bss);
        build/asm/libapi/a25.o(.bss);
        build/asm/libetc/intr_vb.o(.bss);
        build/asm/libetc/intr_dma.o(.bss);
        build/asm/code_9BBC_setget.o(.bss);
        build/asm/9BEC.o(.bss);
        build/asm/libcard/patch.o(.bss);
        build/asm/D554.o(.bss);
        build/asm/D5D4.o(.bss);
        build/asm/libc/c40.o(.bss);
        build/asm/E3F4.o(.bss);
        build/asm/CAMERA.o(.bss);
        build/asm/libgte/msc01.o(.bss);
        build/asm/libgte/mtx_000.o(.bss);
        build/asm/libgte/mtx_001.o(.bss);
        build/asm/libgte/mtx_003.o(.bss);
        build/asm/libgte/mtx_01.o(.bss);
        build/asm/libgte/mtx_09.o(.bss);
        build/asm/libgte/mtx_12.o(.bss);
        build/asm/libgte/func_8001EBC8.o(.bss);
        build/asm/libgte/ratan.o(.bss);
        build/asm/F568.o(.bss);
        build/asm/libgte/reg10.o(.bss);
        build/asm/LIBPOLY.o(.bss);
        build/asm/OBJECT.o(.bss);
        build/asm/libgte/mtx_11.o(.bss);
        build/asm/libgte/smp_04.o(.bss);
        build/asm/LP_OT.o(.bss);
        build/asm/libgpu/p07.o(.bss);
        build/asm/LP_ANM.o(.bss);
        build/asm/LP_GMD.o(.bss);
        build/asm/LP_MODEL.o(.bss);
        build/asm/LP_MAT.o(.bss);
        build/asm/LIGHT_0.o(.bss);
        build/asm/18FB8.o(.bss);
        build/asm/libpad/pdcmd1.o(.bss);
        build/asm/libpad/pdcmd2.o(.bss);
        build/asm/1EDD8.o(.bss);
        build/asm/1EF38.o(.bss);
        build/asm/1F008.o(.bss);
        build/asm/1F108.o(.bss);
        build/asm/1FD08.o(.bss);
        build/asm/21B78.o(.bss);
        build/asm/2AE58.o(.bss);
        build/asm/UNPAC.o(.bss);
        build/asm/SYSPROC.o(.bss);
        build/asm/GPUMAN.o(.bss);
        build/asm/libgpu/e03.o(.bss);
        build/asm/libgpu/e04.o(.bss);
        build/asm/2FE94.o(.bss);
        build/asm/2FEC4.o(.bss);
        build/asm/libgpu/p33.o(.bss);
        build/asm/SOUND.o(.bss);
        build/asm/libsnd/ut_roff.o(.bss);
        build/asm/libsnd/ut_ron.o(.bss);
        build/asm/libspu/s_sr.o(.bss);
        build/asm/libspu/s_m_util.o(.bss);
        build/asm/libspu/s_srmp.o(.bss);
        build/asm/libspu/s_sra.o(.bss);
        build/asm/libspu/s_rrwa.o(.bss);
        build/asm/36B30.o(.bss);
        build/asm/libapi/a10.o(.bss);
        build/asm/36D20.o(.bss);
        build/asm/libc/c31.o(.bss);
        build/asm/36E50.o(.bss);
        build/asm/37120.o(.bss);
        build/asm/37450.o(.bss);
        build/asm/379D0.o(.bss);
        build/asm/37E80.o(.bss);
        build/asm/37F10.o(.bss);
        build/asm/38350.o(.bss);
        build/asm/38530.o(.bss);
        build/asm/38AA0.o(.bss);
        build/asm/38AE0.o(.bss);
        build/asm/38FB0.o(.bss);
        build/asm/39000.o(.bss);
        build/asm/3DDA0.o(.bss);
        build/asm/3DE50.o(.bss);
        build/asm/libc/c20.o(.bss);
        build/asm/3F2B4.o(.bss);
        build/asm/TEXMAN.o(.bss);
        build/asm/MAINSUB.o(.bss);
        build/asm/mainproc.o(.bss);
        build/asm/MEMCARD.o(.bss);
        build/asm/libmcrd/libmcrd.o(.bss);
        build/asm/libapi/a50.o(.bss);
        build/asm/libapi/a51.o(.bss);
        build/asm/libapi/a54.o(.bss);
        build/asm/libapi/a67.o(.bss);
        build/asm/libapi/first.o(.bss);
        build/asm/libapi/a66.o(.bss);
        build/asm/libcard/c171.o(.bss);
        build/asm/libcard/c172.o(.bss);
        build/asm/libcard/card.o(.bss);
        build/asm/libcard/a78.o(.bss);
        build/asm/libcard/a80.o(.bss);
        build/asm/libmcrd/userfunc.o(.bss);
        build/asm/libmcrd/bios.o(.bss);
        build/asm/libmcrd/low.obj.o(.bss);
        build/asm/libcard/a79.o(.bss);
        build/asm/4A444.o(.bss);
        build/asm/4AEF0.o(.bss);
        build/asm/4AF30.o(.bss);
        build/asm/4AF60.o(.bss);
        build/asm/libsnd/ut_ako.obj.o(.bss);
        build/asm/libgte/smp_01_1.o(.bss);
        build/asm/DISPBMP.o(.bss);
        build/asm/TMD_SCAN.o(.bss);
        build/asm/MEMMENU.o(.bss);
        build/asm/WINDOW.o(.bss);
        build/asm/51160.o(.bss);
        build/asm/51540.o(.bss);
        build/asm/51600.o(.bss);
        build/asm/516C0.o(.bss);
        build/asm/517C0.o(.bss);
        build/asm/518E0.o(.bss);
        build/asm/519C0.o(.bss);
        build/asm/EFFECT.o(.bss);
        main_BSS_END = .;
        main_BSS_SIZE = ABSOLUTE(main_BSS_END - main_BSS_START);
    }
    __romPos += SIZEOF(.main);
    __romPos = ALIGN(__romPos, 16);
    main_ROM_END = __romPos;
    main_VRAM_END = .;

    /DISCARD/ :
    {
        *(*);
    }
}
